## boards/shields/capricorne/Kconfig.defconfig
```kconfig
if SHIELD_CAPRICORNE_LEFT

config ZMK_KEYBOARD_NAME
    default "CapriCorne"

config ZMK_SPLIT_ROLE_CENTRAL
    default y

config ZMK_USB
    default y

endif

if SHIELD_CAPRICORNE_LEFT || SHIELD_CAPRICORNE_RIGHT

config ZMK_SPLIT
    default y

endif
```

## boards/shields/capricorne/Kconfig.shield
```kconfig
config SHIELD_CAPRICORNE_LEFT
    def_bool $(shields_list_contains,capricorne_left)

config SHIELD_CAPRICORNE_RIGHT
    def_bool $(shields_list_contains,capricorne_right)
```
