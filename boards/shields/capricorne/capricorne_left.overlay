#include "capricorne.dtsi"

&default_transform {
    col-offset = <6>;
};

&default_kscan {
    col-gpios = <&pro_micro 1 GPIO_ACTIVE_HIGH>,
                <&pro_micro 0 GPIO_ACTIVE_HIGH>,
                <&pro_micro 2 GPIO_ACTIVE_HIGH>,
                <&pro_micro 3 GPIO_ACTIVE_HIGH>,
                <&pro_micro 4 GPIO_ACTIVE_HIGH>,
                <&pro_micro 5 GPIO_ACTIVE_HIGH>;
};